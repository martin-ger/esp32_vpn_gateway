## main/Kconfig.projbuild
```kconfig
menu "Example Configuration"

    config STORE_HISTORY
        bool "Store command history in flash"
        default y
        help
            Linenoise line editing library provides functions to save and load
            command history. If this option is enabled, initalizes a FAT filesystem
            and uses it to store command history.

endmenu

menu "NAT Router Uplink"

    choice UPLINK_TYPE
        prompt "Uplink interface"
        default WIFI_STA_UPLINK
        config WIFI_STA_UPLINK
            bool "WiFi STA"
        config ETH_UPLINK
            bool "Ethernet (LAN8720)"
    endchoice

    config ETH_MDC_GPIO
        int "ETH MDC GPIO"
        default 23
        depends on ETH_UPLINK

    config ETH_MDIO_GPIO
        int "ETH MDIO GPIO"
        default 18
        depends on ETH_UPLINK

    config ETH_PHY_ADDR
        int "ETH PHY address"
        default 1
        depends on ETH_UPLINK

    config ETH_PHY_POWER_GPIO
        int "ETH PHY power GPIO (-1 for none)"
        default 16
        depends on ETH_UPLINK

    config ETH_RMII_CLK_OUTPUT_GPIO
        int "RMII clock output GPIO (-1 = input from PHY)"
        default -1
        depends on ETH_UPLINK
        help
            Set to the GPIO number on which the ESP32 should generate the 50 MHz
            RMII reference clock (e.g. GPIO 17 for the Olimex ESP32-POE-ISO).
            Leave at -1 when the PHY provides the clock (e.g. WT32-ETH01).

endmenu

menu "MQTT Broker"

    config MQTT_BROKER
        bool "Enable built-in MQTT broker"
        default y
        help
            Runs a local MQTT broker (espressif/mosquitto port), e.g.
            mqtt://192.168.4.1:1883. The listener is on 0.0.0.0 and
            connections are accepted only on the interfaces selected with
            'mqtt bind' (AP by default; STA/ETH and VPN optional). No TLS
            transport in this port. Off at runtime until 'mqtt enable'.
            Adds ~60 KB flash; ~2 kB heap plus ~4 kB per connected client.

    config MQTT_BROKER_MAX_CLIENTS
        int "Maximum concurrent MQTT clients"
        default 4
        range 1 8
        depends on MQTT_BROKER
        help
            Connections beyond this are closed right after accept. Every
            client holds an lwIP socket (CONFIG_LWIP_MAX_SOCKETS is shared
            with the web server, remote console, PCAP and syslog) and heap.

    config MQTT_BROKER_MAX_PACKET
        int "Maximum MQTT packet size (bytes)"
        default 4096
        range 256 65536
        depends on MQTT_BROKER
        help
            Largest MQTT packet the broker accepts, including CONNECT
            (checked before authentication). The broker allocates an
            incoming packet at its declared size, so this bounds the heap
            a single client can claim. Larger packets disconnect the
            client.

    config MQTT_HA
        bool "Home Assistant discovery topics"
        default y
        depends on MQTT_BROKER
        help
            Lets the built-in broker publish router telemetry, per-client
            stats and Home Assistant discovery configs itself, and act on
            the HA command topics (restart, web UI, remote console, AP).
            No MQTT client library: messages are injected into the local
            broker. Switched on at run time with 'mqtt ha on' or the web
            UI (off by default). Home Assistant connects to this broker.

    config MQTT_HA_DEFAULT_INTERVAL
        int "Default Home Assistant state interval (seconds)"
        default 30
        range 5 3600
        depends on MQTT_HA

endmenu

menu "WireGuard Server"

    config WG_SERVER
        bool "Enable WireGuard server (inbound VPN)"
        default n
        select WIREGUARD_SERVER
        help
            Lets remote WireGuard clients connect to the router and reach the
            AP network (routed) and the uplink network and internet (NAT).
            Mutually exclusive with the WireGuard client uplink at runtime.
            Enabled for the ESP32 and ESP32-S3 variants (not C3/C5/C6). Selects the
            server API of the esp_wireguard component (WIREGUARD_SERVER), which
            raises WIREGUARD_MAX_PEERS to 8 (about 1 KB RAM per peer slot while a
            WireGuard interface exists).

endmenu
```
